## main/Kconfig.projbuild
```kconfig
menu "Web TMC"

config BUTTON_PIN
    int "Button GPIO Pin"
    default 35  # Default to GPIO_NUM_35 for T-Display
    help
        Select the GPIO pin number used for the button.

endmenu
```
